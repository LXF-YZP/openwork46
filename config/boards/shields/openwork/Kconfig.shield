## config/boards/shields/openwork/Kconfig.shield
```kconfig
# Copyright (c) 2022 Duccio Breschi
# SPDX-License-Identifier: MIT

config SHIELD_OPENWORK_CENTRAL_DONGLE
    def_bool $(shields_list_contains,openwork_central_dongle)

config SHIELD_OPENWORK_CENTRAL_LEFT
    def_bool $(shields_list_contains,openwork_central_left)
    
config SHIELD_OPENWORK_PERIPHERAL_LEFT
    def_bool $(shields_list_contains,openwork_peripheral_left)

config SHIELD_OPENWORK_PERIPHERAL_RIGHT
    def_bool $(shields_list_contains,openwork_peripheral_right)
```
